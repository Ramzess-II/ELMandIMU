## components/obd/Kconfig
```kconfig
menu "NoGPS OBD (ELM327)"

    config NOGPS_OBD_UART_PORT
        int "Номер UART"
        default 1

    config NOGPS_OBD_TX
        int "TX GPIO (к RX адаптера)"
        default 4 if IDF_TARGET_ESP32C3
        default 5

    config NOGPS_OBD_RX
        int "RX GPIO (от TX адаптера)"
        default 5 if IDF_TARGET_ESP32C3
        default 6

    config NOGPS_OBD_SIMULATE
        bool "Имитация OBD всегда: скорость по синусу 0–60 км/ч, UART не трогается"
        default n
        help
            Для проверки блока на столе без адаптера (ТЗ, раздел 13). Период 60 с, половину времени
            скорость 0, чтобы проверялись и стоянки. Обычно удобнее не этот пункт, а настройка
            bench (команда SET,bench,1 и перезагрузка): прошивка остаётся одна для всех плат.

endmenu
```

## main/Kconfig.projbuild
```kconfig
menu "NoGPS"

    config NOGPS_BOARD
        string "Вариант платы (уходит в строку NGI: по нему приложение выбирает файл прошивки)"
        default "c3supermini" if IDF_TARGET_ESP32C3
        default "s3zero"

    config NOGPS_WIFI_PASS
        string "Пароль Wi-Fi по умолчанию (8–63 символа, меняется командой SET)"
        default "12345678"

    config NOGPS_BT_PIN
        string "Код сопряжения Bluetooth по умолчанию (6 цифр, меняется командой SET)"
        default "123456"

    config NOGPS_TEST_FLASH_STRESS
        bool "Проверка: запись во флеш в фоне (портит неработающий раздел прошивки)"
        default n
        help
            Только для стола. Через 10 с после запуска прошивка начинает стирать и записывать
            неработающий раздел приложения, сектор за сектором, как при приёме обновления, но гироскоп
            при этом не усыпляется. Так проверяется, что обмен с гироскопом переживает запись во флеш.
            После проверки блок нужно перешить обычной сборкой.

    config NOGPS_TEST_STATUS_POLL
        bool "Проверка: частый опрос состояния гироскопа"
        default n
        help
            Только для стола. Отдельная задача спрашивает состояние гироскопа сотни тысяч раз в секунду
            и считает ответы «задача гироскопа стоит». Гироскоп при этом работает, так что каждый такой
            ответ ложный. Счёт печатается в лог раз в 10 с.

    menu "IMU"
        config NOGPS_IMU_I2C_PORT
            int "Номер I2C"
            default 0
        config NOGPS_IMU_SDA
            int "SDA GPIO"
            default 6 if IDF_TARGET_ESP32C3
            default 8
        config NOGPS_IMU_SCL
            int "SCL GPIO"
            default 7 if IDF_TARGET_ESP32C3
            default 9
        config NOGPS_IMU_I2C_FREQ
            int "Частота I2C, Гц"
            default 400000
        config NOGPS_IMU_ODR
            int "Частота IMU, Гц (драйвер выберет ближайшую не ниже)"
            default 400
        config NOGPS_IMU_GYRO_RANGE
            int "Диапазон гироскопа, °/с"
            default 250
        config NOGPS_IMU_ACCEL_RANGE
            int "Диапазон акселерометра, g"
            default 4
        config NOGPS_IMU_LPF
            int "Встроенный фильтр, Гц"
            default 40
    endmenu

endmenu
```
